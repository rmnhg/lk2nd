// SPDX-License-Identifier: GPL-2.0-only

/dts-v1/;

#include <skeleton.dtsi>

/ {
	// This is used by the bootloader to find the correct DTB
	compatible = "sony,flamingo", "qcom,msm8926-mtp", "qcom,msm8926", "qcom,mtp", "lk2nd,device";
	qcom,msm-id = <200 0>, <224 0>, <200 0x10001>, <224 0x10001>;
	qcom,board-id = <8 0>;

	model = "Sony Xperia E3";
};
